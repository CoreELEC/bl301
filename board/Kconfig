## board/Kconfig
```kconfig
config GENERIC_GX
	bool "Support Generic gxl board"
	default n

config GENERIC_G12B
	bool "Support Generic g12b board"
	default n

config GENERIC_SM1
	bool "Support Generic sm1 board"
	default n

config KHADAS_VIM3
	bool "Support Khadas VIM3 board"
	default n

config KHADAS_VIM3L
	bool "Support Khadas VIM3L board"
	default n

if GENERIC_GX
source "board/generic/gxl/Kconfig"
endif

if GENERIC_G12B
source "board/generic/g12b/Kconfig"

config SYS_CONFIG_NAME
	default "generic_g12b"
endif

if GENERIC_SM1
source "board/generic/g12b/Kconfig"

config SYS_CONFIG_NAME
	default "generic_sm1"
endif

if KHADAS_VIM3
source "board/khadas/kvim3/Kconfig"

config SYS_CONFIG_NAME
	default "kvim3"
endif

if KHADAS_VIM3L
source "board/khadas/kvim3/Kconfig"

config SYS_CONFIG_NAME
	default "kvim3l"
endif
```

## board/bananapi/m5/Kconfig
```kconfig
config SYS_CPU
	string
	default "armv8"

config SYS_BOARD
	string
	default "m5"

config SYS_VENDOR
	string
	default "bananapi"

config SYS_SOC
	string
	default "g12a"
```

## configs/Bananapi_M2Pro_2b_defconfig
```kconfig
CONFIG_ARM=y
CONFIG_TARGET_MESON_G12A=y
CONFIG_BANANAPI_M2PRO=y
CONFIG_DM=y
CONFIG_DM_GPIO=y
```

## configs/Bananapi_M5_2b_defconfig
```kconfig
CONFIG_ARM=y
CONFIG_TARGET_MESON_G12A=y
CONFIG_BANANAPI_M5=y
CONFIG_DM=y
CONFIG_DM_GPIO=y
```
